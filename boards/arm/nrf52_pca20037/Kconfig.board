## boards/arm/nrf52_pca20037/Kconfig.board
```kconfig
# Kconfig - nRF52 PCA10040 board configuration
#
# Copyright (c) 2019 Nordic Semiconductor ASA
#
# SPDX-License-Identifier: Apache-2.0

config  BOARD_NRF52_PCA20037
	bool "nRF52 PCA20037"
	depends on SOC_NRF52832_QFAA
```

## drivers/Kconfig
```kconfig
#
# Copyright (c) 2018 Nordic Semiconductor
#
# SPDX-License-Identifier: LicenseRef-BSD-5-Clause-Nordic
#

menu "Device Drivers"

rsource "lte_link_control/Kconfig"

menuconfig PCA63548_DRIVERS
	bool "Demopack drivers"
	default n
	help
	  Enable demopack drivers

if PCA63548_DRIVERS

config PCA63548_ORIENTATION_DETECTOR_DRIVER
	bool "Enable orientation detector driver"
	default n

config PCA63548_GPS_DRIVER
	bool "Enable GPS Driver"
	default n

endif #PCA63548_DRIVERS

endmenu
```
