## prj.conf
```kconfig
# General config
CONFIG_NEWLIB_LIBC=y
CONFIG_TEST_RANDOM_GENERATOR=y
CONFIG_ASSERT=y
CONFIG_REBOOT=y

# Trusted execution
CONFIG_TRUSTED_EXECUTION_NONSECURE=y

# Network
CONFIG_NETWORKING=y
CONFIG_NET_SOCKETS=y
CONFIG_NET_SOCKETS_OFFLOAD=y

# MQTT
CONFIG_MQTT_SOCKET_LIB=y
CONFIG_MQTT_LIB_TLS=y
CONFIG_MQTT_MAX_PACKET_LENGTH=2048

# LTE link control
CONFIG_POWER_OPTIMIZATION_ENABLE=n
CONFIG_LTE_LINK_CONTROL=y
CONFIG_LTE_AUTO_INIT_AND_CONNECT=n

# BSD library
CONFIG_BSD_LIBRARY=y

# nRF Cloud
CONFIG_NRF_CLOUD=y

# Sensors
CONFIG_GPS_USE_SIM=y
CONFIG_ACCEL_USE_SIM=y

# Library for buttons and LEDs
CONFIG_DK_LIBRARY=y
CONFIG_DK_LIBRARY_INVERT_LEDS=n

# Console
CONFIG_CONSOLE_SUBSYS=y
CONFIG_CONSOLE_HANDLER=y
CONFIG_CONSOLE_GETCHAR=y

# Main thread
CONFIG_MAIN_THREAD_PRIORITY=7

# Heap and stacks
CONFIG_HEAP_MEM_POOL_SIZE=16384
CONFIG_MAIN_STACK_SIZE=8192
CONFIG_GPS_SIM_THREAD_STACK_SIZE=1024

CONFIG_PCA63548_DRIVERS=y
CONFIG_PCA63548_ORIENTATION_DETECTOR_DRIVER=y
CONFIG_PCA63548_GPS_DRIVER=y

CONFIG_SPI=y
CONFIG_SPI_NRFX=y
CONFIG_SPI_NRFX_RAM_BUFFER_SIZE=8
CONFIG_SPI_3=y
CONFIG_SPI_3_NRF_SPIM=y

CONFIG_DEBUG=y
```

## nrf9160_pca10090.overlay
```dts
&spi3 {
	status = "ok";
	sck-pin = <13>;
	mosi-pin = <11>;
	miso-pin = <12>;
};
```

## src/main.c
```c
/*
 * Copyright (c) 2018 Nordic Semiconductor ASA
 *
 * SPDX-License-Identifier: LicenseRef-BSD-5-Clause-Nordic
 */

#include <zephyr.h>
#include <stdio.h>
#include <string.h>
#include <gps.h>
#include <sensor.h>
#include <console.h>
#include <nrf_cloud.h>
#include <dk_buttons_and_leds.h>
#include <lte_lc.h>
#include <misc/reboot.h>
#include <bsd.h>

#include "nrf_socket.h"
#include <gpio.h>
//#include "orientation_detector.h"
#include <spi.h>
#include <pca63548_orientation_detector.h>
#include <pca63548_gps.h>

#define SPI_DEV DT_SPI_3_NAME

#define CS_CTRL_GPIO_DRV_NAME DT_GPIO_P0_DEV_NAME

struct spi_cs_control spi_od_cs = {
	.gpio_pin = 10,
	.delay = 0,
};
#define SPI_OD_CS (&spi_od_cs)

static struct device *spi_dev;
static int od_cs_ctrl_gpio_config(void)
{
	spi_od_cs.gpio_dev = device_get_binding(CS_CTRL_GPIO_DRV_NAME);
	if (!spi_od_cs.gpio_dev) {
		printk("Cannot find %s!\n",
			    CS_CTRL_GPIO_DRV_NAME);
		return -1;
	}
   	gpio_pin_write(spi_od_cs.gpio_dev, spi_od_cs.gpio_pin, 1);
	return 0;
}

static struct spi_config spi_od_master = {
	.frequency = 8000000,
	.operation = SPI_OP_MODE_MASTER | SPI_MODE_CPOL | SPI_MODE_CPHA |
		     SPI_WORD_SET(8) | SPI_LINES_SINGLE,
	.slave = 0,
	.cs = SPI_OD_CS,
};

struct spi_cs_control spi_gps_cs = {
	.gpio_pin = 23,
	.delay = 0,
};
#define SPI_GPS_CS (&spi_gps_cs)

static int gps_cs_ctrl_gpio_config(void)
{
	spi_gps_cs.gpio_dev = device_get_binding(CS_CTRL_GPIO_DRV_NAME);
	if (!spi_gps_cs.gpio_dev) {
		printk("Cannot find %s!\n",
			    CS_CTRL_GPIO_DRV_NAME);
		return -1;
	}
  	gpio_pin_write(spi_gps_cs.gpio_dev, spi_gps_cs.gpio_pin, 1); 

	return 0;
}

static struct spi_config spi_gps_master = {
	.frequency = 4000000,
	.operation = SPI_OP_MODE_MASTER | SPI_MODE_CPHA | SPI_WORD_SET(8) | SPI_LINES_SINGLE,
	.slave = 0,
	.cs = SPI_GPS_CS,
};

static struct device *gps_io;

/* Interval in milliseconds between each time status LEDs are updated. */
#define LEDS_UPDATE_INTERVAL	        500

/* Interval in microseconds between each time LEDs are updated when indicating
 * that an error has occurred.
 */
#define LEDS_ERROR_UPDATE_INTERVAL      250000

#define BUTTON_1			BIT(0)
#define BUTTON_2			BIT(1)
#define SWITCH_1			BIT(2)
#define SWITCH_2			BIT(3)

#define LED_ON(x)			(x)
#define LED_BLINK(x)			((x) << 8)
#define LED_GET_ON(x)			((x) & 0xFF)
#define LED_GET_BLINK(x)		(((x) >> 8) & 0xFF)

#if !defined(CONFIG_LTE_LINK_CONTROL)
#error "Missing CONFIG_LTE_LINK_CONTROL"
#endif /* !defined(CONFIG_LTE_LINK_CONTROL) */

#if defined(CONFIG_LTE_AUTO_INIT_AND_CONNECT) && \
	defined(CONFIG_NRF_CLOUD_PROVISION_CERTIFICATES)
#error "PROVISION_CERTIFICATES \
	requires CONFIG_LTE_AUTO_INIT_AND_CONNECT to be disabled!"
#endif /* defined(CONFIG_LTE_AUTO_INIT_AND_CONNECT)
	* defined(CONFIG_NRF_CLOUD_PROVISION_CERTIFICATES)
	*/

enum {
	LEDS_INITIALIZING     = LED_ON(0),
	LEDS_CONNECTING       = LED_BLINK(DK_LED3_MSK),
	LEDS_PATTERN_WAIT     = LED_BLINK(DK_LED3_MSK | DK_LED4_MSK),
	LEDS_PATTERN_ENTRY    = LED_ON(DK_LED3_MSK) | LED_BLINK(DK_LED4_MSK),
	LEDS_PATTERN_DONE     = LED_BLINK(DK_LED4_MSK),
	LEDS_PAIRED           = LED_ON(DK_LED4_MSK),
	LEDS_ERROR            = LED_ON(DK_ALL_LEDS_MSK)
} display_state;

 /* Variables to keep track of nRF cloud user association. */
static u8_t ua_pattern[10];
static int buttons_to_capture;
static int buttons_captured;
static bool pattern_recording;
static struct k_sem user_assoc_sem;

/* Sensor data */
static struct gps_data nmea_data;
static struct nrf_cloud_sensor_data flip_cloud_data;
static struct nrf_cloud_sensor_data gps_cloud_data;
static atomic_val_t send_data_enable;

/* Flag used for flip detection */
static bool flip_mode_enabled = true;

/* Structures for work */
static struct k_delayed_work leds_update_work;
static struct k_work connect_work;
static struct k_delayed_work pca63548_sensor_polling_work;

enum error_type {
	ERROR_NRF_CLOUD,
	ERROR_BSD_RECOVERABLE,
	ERROR_BSD_IRRECOVERABLE,
	ERROR_LTE_LC
};

/* Forward declaration of functions */
static void cloud_connect(struct k_work *work);
static void flip_poll(void);
static void sensors_init(void);
static void work_init(void);
static void sensor_data_send(struct nrf_cloud_sensor_data *data);

/**@brief nRF Cloud error handler. */
void error_handler(enum error_type err_type, int err_code)
{
	if (err_type == ERROR_NRF_CLOUD) {
		k_sched_lock();

		/* Turn off and shutdown modem */
		int err = lte_lc_power_off();
		__ASSERT(err == 0, "lte_lc_power_off failed: %d", err);
		bsd_shutdown();
	}

#if !defined(CONFIG_DEBUG)
	sys_reboot(SYS_REBOOT_COLD);
#else
	u8_t led_pattern;

	switch (err_type) {
	case ERROR_NRF_CLOUD:
		/* Blinking all LEDs ON/OFF in pairs (1 and 4, 2 and 3)
		 * if there is an application error.
		 */
		led_pattern = DK_LED1_MSK | DK_LED4_MSK;
		printk("Error of type ERROR_NRF_CLOUD: %d\n", err_code);
	break;
	case ERROR_BSD_RECOVERABLE:
		/* Blinking all LEDs ON/OFF in pairs (1 and 3, 2 and 4)
		 * if there is a recoverable error.
		 */
		led_pattern = DK_LED1_MSK | DK_LED3_MSK;
		printk("Error of type ERROR_BSD_RECOVERABLE: %d\n", err_code);
	break;
	case ERROR_BSD_IRRECOVERABLE:
		/* Blinking all LEDs ON/OFF if there is an
		 * irrecoverable error.
		 */
		led_pattern = DK_ALL_LEDS_MSK;
		printk("Error of type ERROR_BSD_IRRECOVERABLE: %d\n",
								err_code);
	break;
	default:
		/* Blinking all LEDs ON/OFF in pairs (1 and 2, 3 and 4)
		 * undefined error.
		 */
		led_pattern = DK_LED1_MSK | DK_LED2_MSK;
		printk("Unknown error type: %d err_code: %d\n",
			err_type, err_code);
	break;
	}

	while (true) {
		dk_set_leds(led_pattern & 0x0f);
		k_busy_wait(LEDS_ERROR_UPDATE_INTERVAL);
		dk_set_leds(~led_pattern & 0x0f);
		k_busy_wait(LEDS_ERROR_UPDATE_INTERVAL);
	}
#endif /* CONFIG_DEBUG */
}

void nrf_cloud_error_handler(int err)
{
	error_handler(ERROR_NRF_CLOUD, err);
}

/**@brief Recoverable BSD library error. */
void bsd_recoverable_error_handler(uint32_t err)
{
	error_handler(ERROR_BSD_RECOVERABLE, (int)err);
}

/**@brief Irrecoverable BSD library error. */
void bsd_irrecoverable_error_handler(uint32_t err)
{
	error_handler(ERROR_BSD_IRRECOVERABLE, (int)err);
}

/**@brief Callback for GPS trigger events */
static void gps_trigger_handler(struct device *dev, struct gps_trigger *trigger)
{
	u32_t button_state, has_changed;

	ARG_UNUSED(trigger);
	dk_read_buttons(&button_state, &has_changed);

	if (!(button_state & SWITCH_2) && atomic_get(&send_data_enable)) {
		gps_sample_fetch(dev);
		gps_channel_get(dev, GPS_CHAN_NMEA, &nmea_data);
		gps_cloud_data.data.ptr = nmea_data.str;
		gps_cloud_data.data.len = nmea_data.len;
		gps_cloud_data.tag += 1;

		if (gps_cloud_data.tag == 0) {
			gps_cloud_data.tag = 0x1;
		}

		sensor_data_send(&gps_cloud_data);
	}
}

/**@brief Callback for sensor trigger events */
static void sensor_trigger_handler(struct device *dev,
			struct sensor_trigger *trigger)
{
	ARG_UNUSED(dev);
	ARG_UNUSED(trigger);

	/* No action implemented. */
}

/**@brief Function for polling flip orientation if mode has been enabled. */
static void flip_poll(void)
{
	static pca63548_orientation_state_t last_orientation_state = ORIENTATION_NOT_KNOWN;
	static pca63548_orientation_detector_sensor_data_t sensor_data;

	if (!flip_mode_enabled) {
		return;
	}

	if (pca63548_orientation_detector_poll(&sensor_data) == 0) {
		if (sensor_data.orientation == last_orientation_state) {
			return;
		}

		switch (sensor_data.orientation) {
		case ORIENTATION_NORMAL:
			flip_cloud_data.data.ptr = "NORMAL";
			flip_cloud_data.data.len = sizeof("NORMAL") - 1;
			printk("normal");
			break;
		case ORIENTATION_UPSIDE_DOWN:
			flip_cloud_data.data.ptr = "UPSIDE_DOWN";
			flip_cloud_data.data.len = sizeof("UPSIDE_DOWN") - 1;
			printk("opp_ned");
			break;
		default:
			return;
		}

		sensor_data_send(&flip_cloud_data);

		last_orientation_state = sensor_data.orientation;
	}
}

/**@brief Update LEDs state. */
static void leds_update(struct k_work *work)
{
	static bool led_on;
	static u8_t current_led_on_mask;
	u8_t led_on_mask = current_led_on_mask;

	ARG_UNUSED(work);

	/* Reset LED3 and LED4. */
	led_on_mask &= ~(DK_LED3_MSK | DK_LED4_MSK);

	/* Set LED3 and LED4 to match current state. */
	led_on_mask |= LED_GET_ON(display_state);

	led_on = !led_on;
	if (led_on) {
		led_on_mask |= LED_GET_BLINK(display_state);
	} else {
		led_on_mask &= ~LED_GET_BLINK(display_state);
	}

	if (led_on_mask != current_led_on_mask) {
		dk_set_leds(led_on_mask);
		current_led_on_mask = led_on_mask;
	}

	k_delayed_work_submit(&leds_update_work, LEDS_UPDATE_INTERVAL);
}

/**@brief Update LEDs state. */
static void pca63548_sensor_polling(struct k_work *work)
{
	flip_poll();
	if(!pca63548_gps_poll(nmea_data.str, 80))
	{	
	
		gps_cloud_data.data.ptr = nmea_data.str;
		gps_cloud_data.data.len = strlen(nmea_data.str);
		printk("strlen %d \r\n",gps_cloud_data.data.len);
		if(gps_cloud_data.data.len != 0)
		{
			gps_cloud_data.tag += 1;

			if (gps_cloud_data.tag == 0) {
				gps_cloud_data.tag = 0x1;
			}

			sensor_data_send(&gps_cloud_data);
		}
	}
	ARG_UNUSED(work);

	k_delayed_work_submit(&pca63548_sensor_polling_work, 1000);
}
/**@brief Send sensor data to nRF Cloud. **/
static void sensor_data_send(struct nrf_cloud_sensor_data *data)
{
	int err;

	if (pattern_recording || !atomic_get(&send_data_enable)) {
		return;
	}

	if (data->type == NRF_CLOUD_SENSOR_FLIP) {
		err = nrf_cloud_sensor_data_stream(data);
	} else {
		err = nrf_cloud_sensor_data_send(data);
	}

	if (err) {
		printk("sensor_data_send failed: %d\n", err);
		nrf_cloud_error_handler(err);
	}
}

/**@brief Callback for user association event received from nRF Cloud. */
static void on_user_association_req(const struct nrf_cloud_evt *p_evt)
{
	if (!pattern_recording) {
		k_sem_init(&user_assoc_sem, 0, 1);
		display_state = LEDS_PATTERN_WAIT;
		pattern_recording = true;
		buttons_captured = 0;
		buttons_to_capture = p_evt->param.ua_req.sequence.len;

		printk("Please enter the user association pattern ");

		if (IS_ENABLED(CONFIG_CLOUD_UA_BUTTONS)) {
			printk("using the buttons and switches\n");
		} else if (IS_ENABLED(CONFIG_CLOUD_UA_CONSOLE)) {
			printk("using the console\n");
		}
	}
}

/**@brief Callback for nRF Cloud events. */
static void cloud_event_handler(const struct nrf_cloud_evt *p_evt)
{
	int err;

	switch (p_evt->type) {
	case NRF_CLOUD_EVT_TRANSPORT_CONNECTED:
		printk("NRF_CLOUD_EVT_TRANSPORT_CONNECTED\n");
		break;
	case NRF_CLOUD_EVT_USER_ASSOCIATION_REQUEST:
		printk("NRF_CLOUD_EVT_USER_ASSOCIATION_REQUEST\n");
		on_user_association_req(p_evt);
		break;
	case NRF_CLOUD_EVT_USER_ASSOCIATED:
		printk("NRF_CLOUD_EVT_USER_ASSOCIATED\n");
		break;
	case NRF_CLOUD_EVT_READY:
		printk("NRF_CLOUD_EVT_READY\n");
		display_state = LEDS_PAIRED;
		struct nrf_cloud_sa_param param = {
			.sensor_type = NRF_CLOUD_SENSOR_FLIP,
		};

		err = nrf_cloud_sensor_attach(&param);

		if (err) {
			printk("nrf_cloud_sensor_attach failed: %d\n", err);
			nrf_cloud_error_handler(err);
		}

		param.sensor_type = NRF_CLOUD_SENSOR_GPS;
		err = nrf_cloud_sensor_attach(&param);

		if (err) {
			printk("nrf_cloud_sensor_attach failed: %d\n", err);
			nrf_cloud_error_handler(err);
		}

		sensors_init();
		atomic_set(&send_data_enable, 1);
		break;
	case NRF_CLOUD_EVT_SENSOR_ATTACHED:
		printk("NRF_CLOUD_EVT_SENSOR_ATTACHED\n");
		break;
	case NRF_CLOUD_EVT_SENSOR_DATA_ACK:
		printk("NRF_CLOUD_EVT_SENSOR_DATA_ACK\n");
		break;
	case NRF_CLOUD_EVT_TRANSPORT_DISCONNECTED:
		printk("NRF_CLOUD_EVT_TRANSPORT_DISCONNECTED\n");
		atomic_set(&send_data_enable, 0);
		display_state = LEDS_INITIALIZING;

		/* Reconnect to nRF Cloud. */
		k_work_submit(&connect_work);
		break;
	case NRF_CLOUD_EVT_ERROR:
		printk("NRF_CLOUD_EVT_ERROR, status: %d\n", p_evt->status);
		atomic_set(&send_data_enable, 0);
		display_state = LEDS_ERROR;
		nrf_cloud_error_handler(p_evt->status);
		break;
	default:
		printk("Received unknown %d\n", p_evt->type);
		break;
	}
}

/**@brief Initialize nRF CLoud library. */
static void cloud_init(void)
{
	const struct nrf_cloud_init_param param = {
		.event_handler = cloud_event_handler
	};

	int err = nrf_cloud_init(&param);

	__ASSERT(err == 0, "nRF Cloud library could not be initialized.");
}

/**@brief Connect to nRF Cloud, */
static void cloud_connect(struct k_work *work)
{
	int err;

	ARG_UNUSED(work);

	const enum nrf_cloud_ua supported_uas[] = {
		NRF_CLOUD_UA_BUTTON
	};

	const enum nrf_cloud_sensor supported_sensors[] = {
		NRF_CLOUD_SENSOR_GPS,
		NRF_CLOUD_SENSOR_FLIP
	};

	const struct nrf_cloud_ua_list ua_list = {
		.size = ARRAY_SIZE(supported_uas),
		.ptr = supported_uas
	};

	const struct nrf_cloud_sensor_list sensor_list = {
		.size = ARRAY_SIZE(supported_sensors),
		.ptr = supported_sensors
	};

	const struct nrf_cloud_connect_param param = {
		.ua = &ua_list,
		.sensor = &sensor_list,
	};

	display_state = LEDS_CONNECTING;
	err = nrf_cloud_connect(&param);

	if (err) {
		printk("nrf_cloud_connect failed: %d\n", err);
		nrf_cloud_error_handler(err);
	}
}

/**@brief Send user association information to nRF Cloud. */
static void cloud_user_associate(void)
{
	int err;
	const struct nrf_cloud_ua_param ua = {
		.type = NRF_CLOUD_UA_BUTTON,
		.sequence = {
			.len = buttons_to_capture,
			.ptr = ua_pattern
		}
	};

	err = nrf_cloud_user_associate(&ua);

	if (err) {
		printk("nrf_cloud_user_associate failed: %d\n", err);
		nrf_cloud_error_handler(err);
	}
}

/**@brief Function to keep track of user association input when using
 * buttons and switches to register the association pattern.
 */
static void pairing_button_register(u32_t button_state, u32_t has_changed)
{
	if (buttons_captured < buttons_to_capture) {
		if (display_state == LEDS_PATTERN_WAIT)	{
			display_state = LEDS_PATTERN_ENTRY;
		}

		if (button_state & has_changed & BUTTON_1) {
			ua_pattern[buttons_captured++] =
				NRF_CLOUD_UA_BUTTON_INPUT_3;
			printk("Button 1\n");
		} else if (button_state & has_changed & BUTTON_2) {
			ua_pattern[buttons_captured++] =
				NRF_CLOUD_UA_BUTTON_INPUT_4;
			printk("Button 2\n");
		} else if (has_changed & SWITCH_1) {
			ua_pattern[buttons_captured++] =
				NRF_CLOUD_UA_BUTTON_INPUT_1;
			printk("Switch 1\n");
		} else if (has_changed & SWITCH_2) {
			ua_pattern[buttons_captured++] =
				NRF_CLOUD_UA_BUTTON_INPUT_2;
			printk("Switch 2\n");
		}
	}

	if (buttons_captured == buttons_to_capture) {
		display_state = LEDS_PATTERN_DONE;
		k_sem_give(&user_assoc_sem);
	}
}

/**@brief Callback for button events from the DK buttons and LEDs library. */
static void button_handler(u32_t buttons, u32_t has_changed)
{
	int err;

	if (pattern_recording && IS_ENABLED(CONFIG_CLOUD_UA_BUTTONS)) {
		pairing_button_register(buttons, has_changed);
		return;
	}

	if (has_changed & SWITCH_1) {
	//	flip_poll();
	}

	if ((has_changed & SWITCH_2) &&
	    IS_ENABLED(CONFIG_POWER_OPTIMIZATION_ENABLE)) {
		if (buttons & SWITCH_2) {
			err = lte_lc_edrx_req(false);
			if (err) {
				error_handler(ERROR_LTE_LC, err);
			}
			err = lte_lc_psm_req(true);
			if (err) {
				error_handler(ERROR_LTE_LC, err);
			}
		} else {
			err = lte_lc_psm_req(false);
			if (err) {
				error_handler(ERROR_LTE_LC, err);
			}
			err = lte_lc_edrx_req(true);
			if (err) {
				error_handler(ERROR_LTE_LC, err);
			}
		}
	}
}

/**@brief Processing of user inputs to the application. */
static void input_process(void)
{
	if (!pattern_recording) {
		return;
	}

	if (k_sem_take(&user_assoc_sem, K_NO_WAIT) == 0) {
		cloud_user_associate();
		pattern_recording = false;
		return;
	}

	if (!IS_ENABLED(CONFIG_CLOUD_UA_CONSOLE)) {
		return;
	}

	u8_t c[2];

	c[0] = console_getchar();
	c[1] = console_getchar();

	if (c[0] == 'b' && c[1] == '1') {
		printk("Button 1\n");
		ua_pattern[buttons_captured++] = NRF_CLOUD_UA_BUTTON_INPUT_3;
	} else if (c[0] == 'b' && c[1] == '2') {
		printk("Button 2\n");
		ua_pattern[buttons_captured++] = NRF_CLOUD_UA_BUTTON_INPUT_4;
	} else if (c[0] == 's' && c[1] == '1') {
		printk("Switch 1\n");
		ua_pattern[buttons_captured++] = NRF_CLOUD_UA_BUTTON_INPUT_1;
	} else if (c[0] == 's' && c[1] == '2') {
		printk("Switch 2\n");
		ua_pattern[buttons_captured++] = NRF_CLOUD_UA_BUTTON_INPUT_2;
	}

	if (buttons_captured == buttons_to_capture) {
		k_sem_give(&user_assoc_sem);
	}
}

/**@brief Initializes and submits delayed work. */
static void work_init(void)
{
	k_delayed_work_init(&leds_update_work, leds_update);
	k_delayed_work_init(&pca63548_sensor_polling_work, pca63548_sensor_polling);
	k_work_init(&connect_work, cloud_connect);
	k_delayed_work_submit(&leds_update_work, LEDS_UPDATE_INTERVAL);
}

/**@brief Configures modem to provide LTE link. Blocks until link is
 * successfully established.
 */
static void modem_configure(void)
{
	if (IS_ENABLED(CONFIG_LTE_AUTO_INIT_AND_CONNECT)) {
		/* Do nothing, modem is already turned on
		 * and connected.
		 */
	} else {
		int err;

		printk("LTE LC config ...\n");
		display_state = LEDS_CONNECTING;
		err = lte_lc_init_and_connect();
		__ASSERT(err == 0, "LTE link could not be established.");
	}
}

/**@brief Initializes GPS device and configures trigger if set.
 * Gets initial sample from GPS device.
 */
static void pca63548_init(void)
{

	gps_io = device_get_binding(DT_GPIO_P0_DEV_NAME);
	
	if (od_cs_ctrl_gpio_config()) {
		return;
	}
  	if (gps_cs_ctrl_gpio_config()) {
		return;
	}
  	spi_dev = device_get_binding(SPI_DEV);
	if (!spi_dev) {
		printk("SPI: Device driver not found.\n");
		return;
	}
	printk("got binding\n");
	pca63548_gps_init(spi_dev, &spi_gps_master, gps_io);
	k_sleep(500);
	pca63548_gps_start();
	k_sleep(500);
	pca63548_orientation_detector_init(spi_dev, &spi_od_master); 
}


/**@brief Initializes the sensors that are used by the application. */
static void sensors_init(void)
{

	pca63548_init();

	gps_cloud_data.type = NRF_CLOUD_SENSOR_GPS;
	gps_cloud_data.tag = 0x1;
	gps_cloud_data.data.ptr = nmea_data.str;
	gps_cloud_data.data.len = nmea_data.len;

	flip_cloud_data.type = NRF_CLOUD_SENSOR_FLIP;
	k_delayed_work_submit(&pca63548_sensor_polling_work, 5000);
}

/**@brief Initializes buttons and LEDs, using the DK buttons and LEDs
 * library.
 */
static void buttons_leds_init(void)
{
	int err;

	err = dk_buttons_init(button_handler);
	if (err) {
		printk("Could not initialize buttons, err code: %d\n", err);
	}

	err = dk_leds_init();
	if (err) {
		printk("Could not initialize leds, err code: %d\n", err);
	}

	err = dk_set_leds_state(0x00, DK_ALL_LEDS_MSK);
	if (err) {
		printk("Could not set leds state, err code: %d\n", err);
	}
}

void main(void)
{
	printk("Application started\n");

	buttons_leds_init();
	work_init();
	cloud_init();
	modem_configure();
	cloud_connect(NULL);

	if (IS_ENABLED(CONFIG_CLOUD_UA_CONSOLE)) {
		console_init();
	}

	while (true) {
		nrf_cloud_process();
		input_process();
		if (IS_ENABLED(CONFIG_LOG)) {
			/* if logging is enabled, sleep */
			k_sleep(K_MSEC(10));
		} else {
			/* other, put CPU to idle to save power */
			k_cpu_idle();
		}
	}
}
```
